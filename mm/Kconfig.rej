## mm/Kconfig.rej
```kconfig
--- mm/Kconfig
+++ mm/Kconfig
@@ -249,6 +249,28 @@
 	  See Documentation/vm/ksm.txt for more information: KSM is inactive
 	  until a program has madvised that an area is MADV_MERGEABLE, and
 	  root has set /sys/kernel/mm/ksm/run to 1 (if CONFIG_SYSFS is set).
+choice
+	prompt "Choose PKSM/KSM strategy"
+	default PKSM
+	depends on KSM
+	help
+	  This option allows to select a PKSM/KSM stragety.
+
+config PKSM
+	bool "AnonPage-KSM for page merging"
+	depends on KSM
+	help
+	PKSM is inspired by the Linux kernel project -KSM, but with a fundamentally rewritten core algorithm. With
+	an advanced algorithm, PKSM now can transparently scans all anonymously
+	mapped pages. Since KVM is friendly to KSM, KVM can also benefit from
+	PKSM. Now PKSM has its first stable release and first real world enterprise user.
+
+config KSM_LEGACY
+	bool "Legacy KSM implementation"
+	depends on KSM
+	help
+	The legacy KSM implementation from Redhat.
+endchoice
 
 config DEFAULT_MMAP_MIN_ADDR
         int "Low address space to protect from user allocation"
```
